## config/west.yml
```yaml
manifest:
  remotes:
    # ZMK 官方主线仓库
    - name: zmkfirmware
      url-base: https://github.com/zmkfirmware
    # 第三方模拟摇杆驱动模块的仓库
    - name: badjeff
      url-base: https://github.com/badjeff

  projects:
    # 引入 ZMK 官方核心组件
    - name: zmk
      remote: zmkfirmware
      revision: main
      import: app/west.yml

  self:
    path: config
```
